## conf/layer.conf
```bitbake
# We have a conf and classes directory, add to BBPATH
BBPATH .= ":${LAYERDIR}"

# We have recipes-* directories, add to BBFILES
BBFILES += "${LAYERDIR}/recipes-*/*/*.bb \
            ${LAYERDIR}/recipes-*/*/*.bbappend \
            ${LAYERDIR}/recipes-*/*/*/*.bb \
            ${LAYERDIR}/recipes-*/*/*/*.bbappend"

BBFILE_COLLECTIONS += "meta-rz-demo-lvgl"
BBFILE_PATTERN_meta-rz-demo-lvgl = "^${LAYERDIR}/"
BBFILE_PRIORITY_meta-rz-demo-lvgl = "6"

LAYERDEPENDS_meta-rz-demo-lvgl = "core"
LAYERSERIES_COMPAT_meta-rz-demo-lvgl = "dunfell"
```
